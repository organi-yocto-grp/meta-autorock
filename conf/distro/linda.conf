## conf/distro/linda.conf
```bitbake
require conf/distro/poky.conf
DISTRO = "linda"
DISTRO_NAME = "Autorock Linda Linux"
DISTRO_VERSION = "0.4"
SDK_VENDOR = "-lindasdk"
SDK_VERSION := "${@'${DISTRO_VERSION}'.replace('snapshot-${DATE}','snapshot')}"
MAINTAINER = "Qiang Yu <yuqiang@autorock.com.cn>"

TARGET_VENDOR = "-linda"

INHERIT += "rm_work"

VIRTUAL-RUNTIME_dev_manager = ""
VIRTUAL-RUNTIME_keymaps = ""

DISTRO_FEATURES += "alsa"
DISTRO_FEATURES_remove = "3g irda nfc pci wifi usbgadget usbhost pcmcia"
DISTRO_FEATURES_remove += "nfs zeroconf pulseaudio directfb x11 wayland ptest"
```

## conf/layer.conf
```bitbake
# We have a conf and classes directory, add to BBPATH
BBPATH .= ":${LAYERDIR}"

# We have recipes-* directories, add to BBFILES
BBFILES += "${LAYERDIR}/recipes-*/*/*.bb \
${LAYERDIR}/recipes-*/*/*.bbappend"

BBFILE_COLLECTIONS += "autorock"
BBFILE_PATTERN_autorock = "^${LAYERDIR}/"
BBFILE_PRIORITY_autorock = "5"
LAYERVERSION_autorock = "3"
```

## conf/machine/imx6dlwisehmi.conf
```bitbake
#@TYPE: Machine
#@NAME: Freescale i.MX6DL WiseHMI
#@SOC: i.MX6DL
#@DESCRIPTION: Machine configuration for Freescale i.MX6DL WiseHMI
#@MAINTAINER: Qiang Yu <yuqiang@autorock.com.cn>

require conf/machine/include/imx6wisehmi-common.inc

SOC_FAMILY = "mx6:mx6dl"
```

## conf/machine/include/imx6wisehmi-common.inc
```bitbake
# Provides the i.MX6 WiseHMI common settings

require conf/machine/include/imx-base.inc
require conf/machine/include/tune-cortexa9.inc

SERIAL_CONSOLE = "115200 ttymxc3"

KERNEL_IMAGETYPE = "uImage"

IMAGE_FSTYPES = "tar.bz2"
```
